## boards/shields/t_rex/Kconfig.defconfig
```kconfig
if SHIELD_T_REX

# Name must be less than 16 characters long!
config ZMK_KEYBOARD_NAME
    default "T-Rex"

endif
```

## boards/shields/t_rex/Kconfig.shield
```kconfig
# No whitespace after the comma or in your keyboard name!
config SHIELD_T_REX
    def_bool $(shields_list_contains,t_rex)
```
